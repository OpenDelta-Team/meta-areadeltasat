## conf/layer.conf
```bitbake
# We have a conf and classes directory, append to BBPATH
BBPATH .= ":${LAYERDIR}"

# We have a recipes directory, add to BBFILES
BBFILES += "${LAYERDIR}/recipes-*/*/*.bb ${LAYERDIR}/recipes-*/*/*.bbappend"

BBFILE_COLLECTIONS += "areadeltasat-layer"
BBFILE_PATTERN_areadeltasat-layer := "^${LAYERDIR}/"
BBFILE_PRIORITY_areadeltasat-layer = "7"

AREADELTASAT_BASE := '${@os.path.normpath("${LAYERDIR}/../")}'
# Prevent current directory creeping into sstate objects. Otherwise, building
# in another TOPDIR will cause recipes using this variable to be rebuilt.
AREADELTASAT_BASE[vardepvalue] = 'meta-areadeltasat'

PYTHON_PN = "python3"

LICENSE_PATH += "${LAYERDIR}/licenses"

INSANE_SKIP_${PN} += "already-stripped ldflags"

LAYERSERIES_COMPAT_areadeltasat-layer = "hardknott"

# Revert OE-core insane.bbclass change, where these warnings became errors
ERROR_QA_remove = "already-stripped installed-vs-shipped ldflags compile-host-path \
                    install-host-path pn-overrides unknown-configure-option \
                    useless-rpaths rpaths staticdev"
WARN_QA_append = "already-stripped installed-vs-shipped ldflags compile-host-path \
                    install-host-path pn-overrides unknown-configure-option \
                    useless-rpaths rpaths staticdev"
```
